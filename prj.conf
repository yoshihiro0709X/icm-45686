## CMakeLists.txt
```
cmake_minimum_required(VERSION 3.20.0)
find_package(Zephyr REQUIRED HINTS $ENV{ZEPHYR_BASE})

project(icm-45686)

target_sources(app PRIVATE src/main.c)
```

## prj.conf
```kconfig
CONFIG_SERIAL=y
CONFIG_I2C=y
CONFIG_HW_STACK_PROTECTION=y
CONFIG_GPIO=y
CONFIG_LOG=y
CONFIG_CONSOLE=y
CONFIG_PARTITION_MANAGER_ENABLED=y
CONFIG_USE_SEGGER_RTT=y
CONFIG_ARM_MPU=y
CONFIG_UART_CONSOLE=y
CONFIG_DEBUG_THREAD_INFO=y
CONFIG_LOG_PROCESS_THREAD_SLEEP_MS=100
CONFIG_DEBUG_OPTIMIZATIONS=y
```

## nrf52840dk_nrf52840.overlay
```dts
// To get started, press Ctrl+Space to bring up the completion menu and view the available nodes.

// You can also use the buttons in the sidebar to perform actions on nodes.
// Actions currently available include:

// * Enabling / disabling the node
// * Adding the bus to a bus
// * Removing the node
// * Connecting ADC channels

// For more help, browse the DeviceTree documentation at https://docs.zephyrproject.org/latest/guides/dts/index.html
// You can also visit the nRF DeviceTree extension documentation at https://docs.nordicsemi.com/bundle/nrf-connect-vscode/page/guides/ncs_configure_app.html#devicetree-support-in-the-extension


&i2c0 {
	clock-frequency = <I2C_BITRATE_FAST>;
	compatible = "nordic,nrf-twim";
};
```

## src/main.c
```c
/*
 * Copyright (c) 2024 Xenoma Inc.
 */

#include <stdio.h>
#include <string.h>
#include <zephyr/drivers/gpio.h>
#include <zephyr/drivers/i2c.h>
#include <zephyr/kernel.h>
#include <zephyr/logging/log.h>
#include "ICM-45686.h"
#include "bm1422a.h"
#include "tca9548a.h"

LOG_MODULE_REGISTER(main, LOG_LEVEL_INF);

// for Semaphore
K_SEM_DEFINE(sem_sensor, 0, 1);

/* ----- TWIM Function Start ----- */
static const struct device *dev_twim0 = DEVICE_DT_GET(DT_NODELABEL(i2c0));
static int twim_write(const struct device *dev, uint8_t addr, uint8_t reg, uint8_t *data, uint32_t num_bytes)
{
	int err;
	struct i2c_msg msgs[2];

	/* Send the address to write to */
	msgs[0].buf = &reg;
	msgs[0].len = 1U;
	msgs[0].flags = I2C_MSG_WRITE;

	/* Data to be written, and STOP after this. */
	msgs[1].buf = data;
	msgs[1].len = num_bytes;
	msgs[1].flags = I2C_MSG_WRITE | I2C_MSG_STOP;

	err = i2c_transfer(dev, &msgs[0], 2, addr);
	return err;
}

static int twim_write_noreg(const struct device *dev, uint8_t addr, uint8_t *data, uint32_t num_bytes)
{
	int err;
	struct i2c_msg msgs;

	/* Data to be written, and STOP after this. */
	msgs.buf = data;
	msgs.len = num_bytes;
	msgs.flags = I2C_MSG_WRITE | I2C_MSG_STOP;

	err = i2c_transfer(dev, &msgs, 1, addr);
	k_sleep(K_USEC(10));
	return err;
}

static int twim_read(const struct device *dev, uint8_t addr, uint8_t reg, uint8_t *data, uint32_t num_bytes)
{
	int err;
	struct i2c_msg msgs[2] = {0};

	/* Send the address to read from */
	msgs[0].buf = &reg;
	msgs[0].len = 1U;
	msgs[0].flags = I2C_MSG_WRITE;

	/* Read from device. STOP after this. */
	msgs[1].buf = data;
	msgs[1].len = num_bytes;
	msgs[1].flags = I2C_MSG_READ | I2C_MSG_STOP;

	err = i2c_transfer(dev, &msgs[0], 2, addr);
	return err;
}
/* ----- TWIM Function End ----- */

/* ----- Device Function Start ----- */
// Initialize BM1422AGMV TWIM
bool BM1422A_init(const struct device *dev, uint8_t device_addr)
{
	const uint8_t INIT_CMD[] = {
		BM1422AGMV_CNTL1,
		BM1422AGMV_CNTL4,
		BM1422AGMV_CNTL4 + 1,
		BM1422AGMV_CNTL2,
		BM1422AGMV_AVE_A,
		BM1422AGMV_CNTL3,
	};

	const uint8_t INIT_PARAM[] = {
		(BM1422AGMV_CNTL1_ODR_100Hz | BM1422AGMV_CNTL1_OUT_BIT | BM1422AGMV_CNTL1_PC1),
		0x00,
		0x00,
		0x00,
		BM1422AGMV_AVE_A_AVE4,
		BM1422AGMV_CNTL3_FORCE,
	};
	int err;
    uint8_t twim_buffer[16] = {0};

    // Send parameter
    for (uint8_t i = 0; i < sizeof(INIT_CMD); i++) {
		twim_buffer[0] = INIT_PARAM[i];
		err = twim_write(dev, device_addr, INIT_CMD[i], twim_buffer, 1);
		if (err < 0) {
			LOG_ERR("TWIM Error!(%d)", err);
			return false;
		}
    }

    return true;
}

static bool ICM45686_init(const struct device *dev, uint8_t device_addr)
{
	const uint8_t INIT_CMD[] = {
		REG_MISC2,
		WAIT_MSEC,
		ACCEL_CONFIG0,
		GYRO_CONFIG0,
		IOC_PAD_SCENARIO_AUX_OVRD,
		PWR_MGMT0,
	};
	const uint8_t INIT_PARAM[] = {
		0x02,
		0x0A,
		0x19,
		0x19,
		0x02,
		0x0F,
	};
	int err;
	uint8_t twim_buffer[8] = {0};

	// Check IMU sensor
	err = twim_read(dev, device_addr, WHO_AM_I, twim_buffer, 1);
	if (err < 0) {
		LOG_ERR("Device cannot be found.(%d)", err);
		return false;
	} else if (twim_buffer[0] != I_AM_ICM45686) {
		LOG_ERR("This device is not ICM-45686.");
		return false;
	}

	// Send
	for (uint8_t i = 0; i < sizeof(INIT_CMD); i++) {
		if (INIT_CMD[i] == WAIT_MSEC) {
			k_sleep(K_MSEC(INIT_PARAM[i]));
		} else {
			twim_buffer[0] = INIT_PARAM[i];
			err = twim_write(dev, device_addr, INIT_CMD[i], twim_buffer, 1);
			if (err < 0) {
				LOG_ERR("TWIM Error!(%d)", err);
				return false;
			}
		}
	}
	return true;
}
/* ----- Device Function End ----- */

/* ----- Timer Function Start ----- */
static void read_sensor_work_thread(void)
{
	int err;
	uint8_t twim_buffer[16];
	int16_t accel[3], gyro[3], mag[3];

	while (true) {
		k_sem_take(&sem_sensor, K_FOREVER);

		// ID0
		err = twim_read(dev_twim0, ICM45686_ADDR0, ACCEL_DATA_X1_UI, twim_buffer, 12);
		if (err < 0) {
			LOG_WRN("Failed to read sensor ID0.");
		} else {
			accel[0] = (int16_t)(twim_buffer[1] << 8) | twim_buffer[0];
			accel[1] = (int16_t)(twim_buffer[3] << 8) | twim_buffer[2];
			accel[2] = (int16_t)(twim_buffer[5] << 8) | twim_buffer[4];
			gyro[0] = (int16_t)(twim_buffer[7] << 8) | twim_buffer[6];
			gyro[1] = (int16_t)(twim_buffer[9] << 8) | twim_buffer[8];
			gyro[2] = (int16_t)(twim_buffer[11] << 8) | twim_buffer[10];
			// Display value(s)
			LOG_INF("ACC XYZ ID0 = 0x%04x, 0x%04x, 0x%04x", accel[0], accel[1], accel[2]);
			LOG_INF("GYR XYZ ID0 = 0x%04x, 0x%04x, 0x%04x", gyro[0], gyro[1], gyro[2]);
		}

		err = twim_read(dev_twim0, BM1422AGMV_ADDR0, BM1422AGMV_DATAX, twim_buffer, 6);
		if (err < 0) {
			LOG_WRN("Failed to read sensor ID0.");
		} else {
			mag[0] = (int16_t)(twim_buffer[1] << 8) | twim_buffer[0];
			mag[1] = (int16_t)(twim_buffer[3] << 8) | twim_buffer[2];
			mag[2] = (int16_t)(twim_buffer[5] << 8) | twim_buffer[4];
			// Display value(s)
			LOG_INF("MAG XYZ ID0 = 0x%04x, 0x%04x, 0x%04x", mag[0], mag[1], mag[2]);
		}
		LOG_INF("-----");

		err = twim_read(dev_twim0, ICM45686_ADDR1, ACCEL_DATA_X1_UI, twim_buffer, 12);
		if (err < 0) {
			LOG_WRN("Failed to read sensor ID1.");
		} else {
			accel[0] = (int16_t)(twim_buffer[1] << 8) | twim_buffer[0];
			accel[1] = (int16_t)(twim_buffer[3] << 8) | twim_buffer[2];
			accel[2] = (int16_t)(twim_buffer[5] << 8) | twim_buffer[4];
			gyro[0] = (int16_t)(twim_buffer[7] << 8) | twim_buffer[6];
			gyro[1] = (int16_t)(twim_buffer[9] << 8) | twim_buffer[8];
			gyro[2] = (int16_t)(twim_buffer[11] << 8) | twim_buffer[10];
			// Display value(s)
			LOG_INF("ACC XYZ ID1 = 0x%04x, 0x%04x, 0x%04x", accel[0], accel[1], accel[2]);
			LOG_INF("GYR XYZ ID1 = 0x%04x, 0x%04x, 0x%04x", gyro[0], gyro[1], gyro[2]);
		}

		err = twim_read(dev_twim0, BM1422AGMV_ADDR1, BM1422AGMV_DATAX, twim_buffer, 6);
		if (err < 0) {
			LOG_WRN("Failed to read sensor ID1.");
		} else {
			mag[0] = (int16_t)(twim_buffer[1] << 8) | twim_buffer[0];
			mag[1] = (int16_t)(twim_buffer[3] << 8) | twim_buffer[2];
			mag[2] = (int16_t)(twim_buffer[5] << 8) | twim_buffer[4];
			// Display value(s)
			LOG_INF("MAG XYZ ID1 = 0x%04x, 0x%04x, 0x%04x", mag[0], mag[1], mag[2]);
		}
		LOG_INF("-----");
	}
}
K_THREAD_DEFINE(read_sensor, 1024, read_sensor_work_thread, NULL, NULL, NULL, K_PRIO_PREEMPT(15), 0, 0);

static void timer_stop_handler(struct k_timer *timer)
{
	LOG_INF("Timer stopped.");
}

static void timer_handler(struct k_timer *timer)
{
	// Resume thread
	LOG_DBG("Read sensor(s).");
	k_sem_give(&sem_sensor);
}
K_TIMER_DEFINE(timer, timer_handler, timer_stop_handler);
/* ----- Timer Function End ----- */

int main(void)
{
	int err;
	uint8_t twim_buffer[16] = {0};

	twim_buffer[0] = CHANNEL0_ENABLED;
	err = twim_write_noreg(dev_twim0, TCA9548A_ADDR0, twim_buffer, 1);
	if (err) {
		LOG_WRN("Failed to communicate MUX.");
		return -1;
	}

	//
	if (ICM45686_init(dev_twim0, ICM45686_ADDR0) == false) {
		LOG_WRN("Failed to initialize sensor ID0.");
		return -1;
	}
	if (BM1422A_init(dev_twim0, BM1422AGMV_ADDR0)) {
		LOG_INF("[TWIM 0]MAG sensor ID0 has been initialized.");
	} else {
		LOG_ERR("[TWIM 0]Failed to initialize MAG sensor ID0");
		return -1;
	}
	if (ICM45686_init(dev_twim0, ICM45686_ADDR1) == false) {
		LOG_WRN("Failed to initialize sensor ID1.");
		return -1;
	}
	if (BM1422A_init(dev_twim0, BM1422AGMV_ADDR1)) {
		LOG_INF("[TWIM 0]MAG sensor ID1 has been initialized.");
	} else {
		LOG_ERR("[TWIM 0]Failed to initialize MAG sensor ID1");
		return -1;
	}

	//
	k_timer_start(&timer, K_NO_WAIT, K_MSEC(3000));

	// Main loop
	while (true) {
		k_sleep(K_MSEC(500));
	}
}
```

## src/ICM-45686.h
```c
// I2C Device Addresses
#define ICM45686_ADDR0							(0x68)
#define ICM45686_ADDR1							(0x69)

// Response of WHO_AM_I
#define I_AM_ICM45686							(0xe9)

// Extra
#define WAIT_MSEC						(0xff)

// Register Address
#define ACCEL_DATA_X1_UI				(0x00)
#define ACCEL_DATA_X0_UI				(0x01)
#define ACCEL_DATA_Y1_UI				(0x02)
#define ACCEL_DATA_Y0_UI				(0x03)
#define ACCEL_DATA_Z1_UI				(0x04)
#define ACCEL_DATA_Z0_UI				(0x05)
#define GYRO_DATA_X1_UI					(0x06)
#define GYRO_DATA_X0_UI					(0x07)
#define GYRO_DATA_Y1_UI					(0x08)
#define GYRO_DATA_Y0_UI					(0x09)
#define GYRO_DATA_Z1_UI					(0x0A)
#define GYRO_DATA_Z0_UI					(0x0B)
#define TEMP_DATA1_UI					(0x0C)
#define TEMP_DATA0_UI					(0x0D)
#define TMST_FSYNCH						(0x0E)
#define TMST_FSYNCL						(0x0F)
#define PWR_MGMT0						(0x10)
#define FIFO_COUNT_0					(0x12)
#define FIFO_COUNT_1					(0x13)
#define FIFO_DATA						(0x14)
#define INT1_CONFIG0					(0x16)
#define INT1_CONFIG1					(0x17)
#define INT1_CONFIG2					(0x18)
#define INT1_STATUS0					(0x19)
#define INT1_STATUS1					(0x1A)
#define ACCEL_CONFIG0					(0x1B)
#define GYRO_CONFIG0					(0x1C)
#define FIFO_CONFIG0					(0x1D)
#define FIFO_CONFIG1_0					(0x1E)
#define FIFO_CONFIG1_1					(0x1F)
#define FIFO_CONFIG2					(0x20)
#define FIFO_CONFIG3					(0x21)
#define FIFO_CONFIG4					(0x22)
#define TMST_WOM_CONFIG					(0x23)
#define FSYNC_CONFIG0					(0x24)
#define FSYNC_CONFIG1					(0x25)
#define RTC_CONFIG						(0x26)
#define DMP_EXT_SEN_ODR_CFG				(0x27)
#define ODR_DECIMATE_CONFIG				(0x28)
#define EDMP_APEX_EN0					(0x29)
#define EDMP_APEX_EN1					(0x2A)
#define APEX_BUFFER_MGMT				(0x2B)
#define INTF_CONFIG0					(0x2C)
#define INTF_CONFIG1_OVRD				(0x2D)
#define INTF_AUX_CONFIG					(0x2E)
#define IOC_PAD_SCENARIO				(0x2F)
#define IOC_PAD_SCENARIO_AUX_OVRD		(0x30)
#define DRIVE_CONFIG0					(0x32)
#define DRIVE_CONFIG1					(0x33)
#define DRIVE_CONFIG2					(0x34)
#define INT_APEX_CONFIG0				(0x39)
#define INT_APEX_CONFIG1				(0x3A)
#define INT_APEX_STATUS0				(0x3B)
#define INT_APEX_STATUS1				(0x3C)
#define ACCEL_DATA_X1_AUX1				(0x44)
#define ACCEL_DATA_X0_AUX1				(0x45)
#define ACCEL_DATA_Y1_AUX1				(0x46)
#define ACCEL_DATA_Y0_AUX1				(0x47)
#define ACCEL_DATA_Z1_AUX1				(0x48)
#define ACCEL_DATA_Z0_AUX1				(0x49)
#define GYRO_DATA_X1_AUX1				(0x4A)
#define GYRO_DATA_X0_AUX1				(0x4B)
#define GYRO_DATA_Y1_AUX1				(0x4C)
#define GYRO_DATA_Y0_AUX1				(0x4D)
#define GYRO_DATA_Z1_AUX1				(0x4E)
#define GYRO_DATA_Z0_AUX1				(0x4F)
#define TEMP_DATA1_AUX1					(0x50)
#define TEMP_DATA0_AUX1					(0x51)
#define TMST_FSYNCH_AUX1				(0x52)
#define TMST_FSYNCL_AUX1				(0x53)
#define PWR_MGMT_AUX1					(0x54)
#define FS_SEL_AUX1						(0x55)
#define INT2_CONFIG0					(0x56)
#define INT2_CONFIG1					(0x57)
#define INT2_CONFIG2					(0x58)
#define INT2_STATUS0					(0x59)
#define INT2_STATUS1					(0x5A)
#define WHO_AM_I						(0x72)
#define REG_HOST_MSG					(0x73)
#define IREG_ADDR_15_8					(0x7C)
#define IREG_ADDR_7_0					(0x7D)
#define IREG_DATA						(0x7E)
#define REG_MISC2						(0x7F)

#define IMEM_SRAM						(0x0000)
#define IPREG_BAR						(0xA000)
#define IPREG_SYS1						(0xA400)
#define IPREG_SYS2						(0xA500)
#define IPREG_TOP1						(0xA200)

// User Bank IMEM_SRAM
#define IMEM_SRAM_REG_0					(0x00)
#define IMEM_SRAM_REG_1					(0x01)
#define IMEM_SRAM_REG_2					(0x02)
#define IMEM_SRAM_REG_3					(0x03)
#define IMEM_SRAM_REG_4					(0x04)
#define IMEM_SRAM_REG_5					(0x05)
#define IMEM_SRAM_REG_6					(0x06)
#define IMEM_SRAM_REG_7					(0x07)
#define IMEM_SRAM_REG_8					(0x08)
#define IMEM_SRAM_REG_9					(0x09)
#define IMEM_SRAM_REG_10				(0x0A)
#define IMEM_SRAM_REG_11				(0x0B)
#define IMEM_SRAM_REG_56				(0x38)
#define IMEM_SRAM_REG_57				(0x39)
#define IMEM_SRAM_REG_64				(0x40)
#define IMEM_SRAM_REG_68				(0x44)
#define IMEM_SRAM_REG_92				(0x5C)
#define IMEM_SRAM_REG_96				(0x60)
#define IMEM_SRAM_REG_97				(0x61)
#define IMEM_SRAM_REG_98				(0x62)
#define IMEM_SRAM_REG_99				(0x63)
#define IMEM_SRAM_REG_100				(0x64)
#define IMEM_SRAM_REG_101				(0x65)
#define IMEM_SRAM_REG_102				(0x66)
#define IMEM_SRAM_REG_103				(0x67)
#define IMEM_SRAM_REG_104				(0x68)
#define IMEM_SRAM_REG_105				(0x69)
#define IMEM_SRAM_REG_106				(0x6A)
#define IMEM_SRAM_REG_107				(0x6B)
#define IMEM_SRAM_REG_136				(0x88)
#define IMEM_SRAM_REG_137				(0x89)
#define IMEM_SRAM_REG_138				(0x8A)
#define IMEM_SRAM_REG_139				(0x8B)
#define IMEM_SRAM_REG_141				(0x8D)
#define IMEM_SRAM_REG_142				(0x8E)
#define IMEM_SRAM_REG_143				(0x8F)
#define IMEM_SRAM_REG_144				(0x90)
#define IMEM_SRAM_REG_146				(0x92)
#define IMEM_SRAM_REG_154				(0x9A)
#define IMEM_SRAM_REG_155				(0x9B)
#define IMEM_SRAM_REG_156				(0x9C)
#define IMEM_SRAM_REG_157				(0x9D)
#define IMEM_SRAM_REG_159				(0x9F)
#define IMEM_SRAM_REG_160				(0xA0)
#define IMEM_SRAM_REG_182				(0xB6)
#define IMEM_SRAM_REG_185				(0xB9)
#define IMEM_SRAM_REG_186				(0xBA)
#define IMEM_SRAM_REG_196				(0xC4)
#define IMEM_SRAM_REG_197				(0xC5)
#define IMEM_SRAM_REG_198				(0xC6)
#define IMEM_SRAM_REG_199				(0xC7)
#define IMEM_SRAM_REG_288				(0x120)
#define IMEM_SRAM_REG_289				(0x121)
#define IMEM_SRAM_REG_290				(0x122)
#define IMEM_SRAM_REG_291				(0x123)
#define IMEM_SRAM_REG_292				(0x124)
#define IMEM_SRAM_REG_293				(0x125)
#define IMEM_SRAM_REG_294				(0x126)
#define IMEM_SRAM_REG_295				(0x127)
#define IMEM_SRAM_REG_296				(0x128)
#define IMEM_SRAM_REG_297				(0x129)
#define IMEM_SRAM_REG_298				(0x12A)
#define IMEM_SRAM_REG_299				(0x12B)
#define IMEM_SRAM_REG_304				(0x130)
#define IMEM_SRAM_REG_305				(0x131)
#define IMEM_SRAM_REG_306				(0x132)
#define IMEM_SRAM_REG_307				(0x133)
#define IMEM_SRAM_REG_308				(0x134)
#define IMEM_SRAM_REG_309				(0x135)
#define IMEM_SRAM_REG_316				(0x13C)
#define IMEM_SRAM_REG_317				(0x13D)
#define IMEM_SRAM_REG_318				(0x13E)
#define IMEM_SRAM_REG_319				(0x13F)
#define IMEM_SRAM_REG_320				(0x140)
#define IMEM_SRAM_REG_321				(0x141)
#define IMEM_SRAM_REG_392				(0x188)
#define IMEM_SRAM_REG_393				(0x189)
#define IMEM_SRAM_REG_400				(0x190)
#define IMEM_SRAM_REG_401				(0x191)
#define IMEM_SRAM_REG_402				(0x192)
#define IMEM_SRAM_REG_403				(0x193)
#define IMEM_SRAM_REG_404				(0x194)
#define IMEM_SRAM_REG_405				(0x195)
#define IMEM_SRAM_REG_406				(0x196)
#define IMEM_SRAM_REG_540				(0x21C)
#define IMEM_SRAM_REG_541				(0x21D)
#define IMEM_SRAM_REG_542				(0x21E)
#define IMEM_SRAM_REG_543				(0x21F)
#define IMEM_SRAM_REG_544				(0x220)
#define IMEM_SRAM_REG_545				(0x221)
#define IMEM_SRAM_REG_546				(0x222)
#define IMEM_SRAM_REG_547				(0x223)
#define IMEM_SRAM_REG_548				(0x224)
#define IMEM_SRAM_REG_549				(0x225)
#define IMEM_SRAM_REG_550				(0x226)
#define IMEM_SRAM_REG_551				(0x227)
#define IMEM_SRAM_REG_556				(0x22C)
#define IMEM_SRAM_REG_557				(0x22D)
#define IMEM_SRAM_REG_558				(0x22E)
#define IMEM_SRAM_REG_559				(0x22F)
#define IMEM_SRAM_REG_560				(0x230)
#define IMEM_SRAM_REG_561				(0x231)
#define IMEM_SRAM_REG_562				(0x232)
#define IMEM_SRAM_REG_563				(0x233)
#define IMEM_SRAM_REG_564				(0x234)
#define IMEM_SRAM_REG_565				(0x235)
#define IMEM_SRAM_REG_566				(0x236)
#define IMEM_SRAM_REG_567				(0x237)
#define IMEM_SRAM_REG_568				(0x238)
#define IMEM_SRAM_REG_569				(0x239)
#define IMEM_SRAM_REG_570				(0x23A)
#define IMEM_SRAM_REG_571				(0x23B)
#define IMEM_SRAM_REG_572				(0x23C)
#define IMEM_SRAM_REG_573				(0x23D)
#define IMEM_SRAM_REG_574				(0x23E)
#define IMEM_SRAM_REG_575				(0x23F)
#define IMEM_SRAM_REG_576				(0x240)
#define IMEM_SRAM_REG_577				(0x241)
#define IMEM_SRAM_REG_578				(0x242)
#define IMEM_SRAM_REG_579				(0x243)
#define IMEM_SRAM_REG_580				(0x244)
#define IMEM_SRAM_REG_581				(0x245)
#define IMEM_SRAM_REG_582				(0x246)
#define IMEM_SRAM_REG_583				(0x247)
#define IMEM_SRAM_REG_584				(0x248)
#define IMEM_SRAM_REG_585				(0x249)
#define IMEM_SRAM_REG_586				(0x24A)
#define IMEM_SRAM_REG_587				(0x24B)
#define IMEM_SRAM_REG_988				(0x3DC)
#define IMEM_SRAM_REG_989				(0x3DD)
#define IMEM_SRAM_REG_990				(0x3DE)
#define IMEM_SRAM_REG_991				(0x3DF)
#define IMEM_SRAM_REG_994				(0x3E2)
#define IMEM_SRAM_REG_995				(0x3E3)
#define IMEM_SRAM_REG_1000				(0x3E8)
#define IMEM_SRAM_REG_1001				(0x3E9)
#define IMEM_SRAM_REG_1002				(0x3EA)
#define IMEM_SRAM_REG_1003				(0x3EB)
#define IMEM_SRAM_REG_1004				(0x3EC)
#define IMEM_SRAM_REG_1008				(0x3F0)
#define IMEM_SRAM_REG_1009				(0x3F1)
#define IMEM_SRAM_REG_1010				(0x3F2)
#define IMEM_SRAM_REG_1011				(0x3F3)
#define IMEM_SRAM_REG_1016				(0x3F8)
#define IMEM_SRAM_REG_1017				(0x3F9)
#define IMEM_SRAM_REG_1018				(0x3FA)
#define IMEM_SRAM_REG_1019				(0x3FB)
#define IMEM_SRAM_REG_1042				(0x412)
#define IMEM_SRAM_REG_1168				(0x490)
#define IMEM_SRAM_REG_1203				(0x4B3)

//UserBankIPREG_BAR
#define IPREG_BAR_REG_57				(0x39)
#define IPREG_BAR_REG_58				(0x3A)
#define IPREG_BAR_REG_59				(0x3B)
#define IPREG_BAR_REG_60				(0x3C)
#define IPREG_BAR_REG_61				(0x3D)
#define IPREG_BAR_REG_62				(0x3E)

//UserBank IPREG_TOP1
#define I2CM_COMMAND_0					(0x06)
#define I2CM_COMMAND_1					(0x07)
#define I2CM_COMMAND_2					(0x08)
#define I2CM_COMMAND_3					(0x09)
#define I2CM_DEV_PROFILE0				(0x0E)
#define I2CM_DEV_PROFILE1				(0x0F)
#define I2CM_DEV_PROFILE2				(0x10)
#define I2CM_DEV_PROFILE3				(0x11)
#define I2CM_CONTROL					(0x16)
#define I2CM_STATUS						(0x18)
#define I2CM_EXT_DEV_STATUS				(0x1A)
#define I2CM_RD_DATA0					(0x1B)
#define I2CM_RD_DATA1					(0x1C)
#define I2CM_RD_DATA2					(0x1D)
#define I2CM_RD_DATA3					(0x1E)
#define I2CM_RD_DATA4					(0x1F)
#define I2CM_RD_DATA5					(0x20)
#define I2CM_RD_DATA6					(0x21)
#define I2CM_RD_DATA7					(0x22)
#define I2CM_RD_DATA8					(0x23)
#define I2CM_RD_DATA9					(0x24)
#define I2CM_RD_DATA10					(0x25)
#define I2CM_RD_DATA11					(0x26)
#define I2CM_RD_DATA12					(0x27)
#define I2CM_RD_DATA13					(0x28)
#define I2CM_RD_DATA14					(0x29)
#define I2CM_RD_DATA15					(0x2A)
#define I2CM_RD_DATA16					(0x2B)
#define I2CM_RD_DATA17					(0x2C)
#define I2CM_RD_DATA18					(0x2D)
#define I2CM_RD_DATA19					(0x2E)
#define I2CM_RD_DATA20					(0x2F)
#define I2CM_WR_DATA0					(0x33)
#define I2CM_WR_DATA1					(0x34)
#define I2CM_WR_DATA2					(0x35)
#define I2CM_WR_DATA3					(0x36)
#define I2CM_WR_DATA4					(0x37)
#define I2CM_WR_DATA5					(0x38)
#define SIFS_IXC_ERROR_STATUS			(0x4B)
#define EDMP_PRGRM_IRQ0_0				(0x4F)
#define EDMP_PRGRM_IRQ0_1				(0x50)
#define EDMP_PRGRM_IRQ1_0				(0x51)
#define EDMP_PRGRM_IRQ1_1				(0x52)
#define EDMP_PRGRM_IRQ2_0				(0x53)
#define EDMP_PRGRM_IRQ2_1				(0x54)
#define EDMP_SP_START_ADDR				(0x55)
#define SMC_CONTROL_0					(0x58)
#define SMC_CONTROL_1					(0x59)
#define STC_CONFIG						(0x63)
#define SREG_CTRL						(0x67)
#define SIFS_I3C_STC_CFG				(0x68)
#define INT_PULSE_MIN_ON_INTF0			(0x69)
#define INT_PULSE_MIN_ON_INTF1			(0x6A)
#define INT_PULSE_MIN_OFF_INTF0			(0x6B)
#define INT_PULSE_MIN_OFF_INTF1			(0x6C)
#define ISR_0_7							(0x6E)
#define ISR_8_15						(0x6F)
#define ISR_16_23						(0x70)
#define STATUS_MASK_PIN_0_7				(0x71)
#define STATUS_MASK_PIN_8_15			(0x72)
#define STATUS_MASK_PIN_16_23			(0x73)
#define INT_I2CM_SOURCE					(0x74)
#define ACCEL_WOM_X_THR					(0x7E)
#define ACCEL_WOM_Y_THR					(0x7F)
#define ACCEL_WOM_Z_THR					(0x80)
#define SELFTEST						(0x90)
#define IPREG_MISC						(0x97)
#define SW_PLL1_TRIM					(0xA2)
#define FIFO_SRAM_SLEEP					(0xA7)

//UserBank IPREG_SYS1
#define IPREG_SYS1_REG_42				(0x2A)
#define IPREG_SYS1_REG_43				(0x2B)
#define IPREG_SYS1_REG_56				(0x38)
#define IPREG_SYS1_REG_57				(0x39)
#define IPREG_SYS1_REG_56_				(0x46)
#define IPREG_SYS1_REG_57_				(0x47)
#define IPREG_SYS1_REG_166				(0xA6)
#define IPREG_SYS1_REG_168				(0xA8)
#define IPREG_SYS1_REG_170				(0xAA)
#define IPREG_SYS1_REG_171				(0xAB)
#define IPREG_SYS1_REG_172				(0xAC)

//UserBank IPREG_SYS2
#define IPREG_SYS2_REG_24				(0x18)
#define IPREG_SYS2_REG_25				(0x19)
#define IPREG_SYS2_REG_32				(0x20)
#define IPREG_SYS2_REG_33				(0x21)
#define IPREG_SYS2_REG_40				(0x28)
#define IPREG_SYS2_REG_41				(0x29)
#define IPREG_SYS2_REG_123				(0x7B)
#define IPREG_SYS2_REG_129				(0x81)
#define IPREG_SYS2_REG_130				(0x82)
#define IPREG_SYS2_REG_131				(0x83)
#define IPREG_SYS2_REG_132				(0x84)
```

## src/bm1422a.h
```c
#include <nrfx_twim.h>
#include <zephyr/kernel.h>
#include <zephyr/logging/log.h>

// I2C Device Addresses
#define BM1422AGMV_ADDR0						(0x0e)
#define BM1422AGMV_ADDR1						(0x0f)

// Register List for BM1422AGMV
#define BM1422AGMV_WIA_VAL						(0x41)

#define BM1422AGMV_WIA							(0x0f)
#define BM1422AGMV_DATAX						(0x10)
#define BM1422AGMV_STA1							(0x18)
#define BM1422AGMV_CNTL1						(0x1b)
#define BM1422AGMV_CNTL2						(0x1c)
#define BM1422AGMV_CNTL3						(0x1d)
#define BM1422AGMV_AVE_A						(0x40)
#define BM1422AGMV_CNTL4						(0x5c)

#define BM1422AGMV_STA1_RD_DRDY					(1 << 6)

#define BM1422AGMV_CNTL1_FS1					(1 << 1)
#define BM1422AGMV_CNTL1_ODR_10Hz				(0 << 3)
#define BM1422AGMV_CNTL1_ODR_20Hz				(2 << 3)
#define BM1422AGMV_CNTL1_ODR_100Hz				(1 << 3)
#define BM1422AGMV_CNTL1_ODR_1000Hz				(3 << 3)
#define BM1422AGMV_CNTL1_RST_LV					(1 << 5)
#define BM1422AGMV_CNTL1_OUT_BIT				(1 << 6)
#define BM1422AGMV_CNTL1_PC1					(1 << 7)

#define BM1422AGMV_CNTL2_DRP					(1 << 2)
#define BM1422AGMV_CNTL2_DREN					(1 << 3)

#define BM1422AGMV_CNTL3_FORCE					(1 << 6)

#define BM1422AGMV_AVE_A_AVE4					(0 << 2)

#define BM1422AGMV_14BIT_SENS					(24)
#define BM1422AGMV_12BIT_SENS					(6)
```

## src/tca9548a.h
```c
// I2C Device Addresses
#define TCA9548A_ADDR0							(0x70)
#define TCA9548A_ADDR1							(0x71)
#define TCA9548A_ADDR2							(0x72)
#define TCA9548A_ADDR3							(0x73)
#define TCA9548A_ADDR4							(0x74)
#define TCA9548A_ADDR5							(0x75)
#define TCA9548A_ADDR6							(0x76)
#define TCA9548A_ADDR7							(0x77)

#define CHANNEL_ALL_DISABLED					(0x00)
#define CHANNEL0_ENABLED						(0x01)
#define CHANNEL1_ENABLED						(0x02)
#define CHANNEL2_ENABLED						(0x04)
#define CHANNEL3_ENABLED						(0x08)
#define CHANNEL4_ENABLED						(0x10)
#define CHANNEL5_ENABLED						(0x20)
#define CHANNEL6_ENABLED						(0x40)
#define CHANNEL7_ENABLED						(0x80)
```
